/*
    Automated cat laser pointer.
    Adapted from Laser Tower For The Cat - LA FABRIQUE DIY (http://imgur.com/gallery/kbylT)
    
    Device utilizes two servo motors in a pan/tilt kit and a laser.
    Random movement generated by program commands servos to pan and tilt to direct laser.
    
    x_servo (horizontal movement) is connected to pin 6.
    y_servo (vertical movement) is connected to pin 9.
    Laser is connected to pin 13.
    
    Program generates random position for laser pointer. Angular limits of servos are defined by min_x, max_x, min_y, max_y.
    Program checks if randomly generated position is sufficiently far enough from previous position by minimal_movement.
    After movement, tower stays at position for a time between min_freeze and max_freeze.
    The program will generate a number of random positions equal to the moves variable and wait for delay_ms before repeating.
    The program utilizes the Time library to automatically turn on repetively turn on daily for a set window of hours.
    I use the program to loop between 10AM and 7PM. This is done by initializing the program at 10AM and having an hours of 9.
    
    Created 1/18/17 by Eddie Soller
*/

// Libraries
#include <Servo.h>
#include <Time.h>
#include <TimeLib.h>

// User customizable variables
float min_x = 15;
float max_x = 110;
float min_y = 25;
float max_y = 85;
int min_freeze = 300;
int max_freeze = 3000;
int min_move_time = 15;
int max_move_time = 80;
float minimal_movement = 5;
int moves = 150;
int hours = 9;
int delay_ms = 5000000;

// Set variables
int random_delay;
float x_position = min_x + (max_x - min_x)/2;
float y_position = min_y + (max_y - min_y)/2; 
float x_old_position = x_position;
float y_old_position = y_position;
float x_new_position;
float y_new_position;
float x_speed;
float y_speed;
int movement_time;
int counter;
int time;

// Create servo objects
Servo x_servo;  
Servo y_servo;
int pos = 0;

void setup() {
    Serial.begin(9600);
    
    // Set up servos
    y_servo.attach(6);  // attaches the y servo on pin 6 to the servo object
    x_servo.attach(9);  // attaches the x servo on pin 9 to the servo object
    
    // Set up laser
    pinMode (13, OUTPUT); 
}

void loop() {
    // Reset counter
    counter = 0;
    
    // Measure hours since initialization
    time = hour();
    
    // Check if measured time is less than desired hours

    if(time >= hours) {
        // Turn on servos and laser
        y_servo.attach(6);
        x_servo.attach(9);
        digitalWrite(13, HIGH);
        
        // Start making random movements till desired moves reached
        for(counter = 0;  counter <= moves; counter++) { 
            // Create random values
            movement_time = random(min_move_time, max_move_time);
            random_delay = random(min_freeze, max_freeze);
            x_new_position = random(min_x+minimal_movement, max_x-minimal_movement);
            y_new_position = random(min_y+minimal_movement, max_y-minimal_movement);
            
            if( (y_new_position > y_old_position) && (abs(y_new_position - y_old_position) < 5 )) {
                y_new_position = y_new_position + minimal_movement;
            }  
            else if ( (y_new_position < y_old_position) && (abs(y_new_position - y_old_position) < 5 )) {
                y_new_position = y_new_position - minimal_movement;
            }
            if( (x_new_position > x_old_position) && (abs(x_new_position - x_old_position) < 5 )) {
                x_new_position = x_new_position + minimal_movement;
            }  
            else if ( (x_new_position < x_old_position) && (abs(x_new_position - x_old_position) < 5 )) {
                x_new_position = x_new_position - minimal_movement;
            }
            
            x_speed = (x_new_position - x_old_position)/movement_time;
            y_speed = (y_new_position - y_old_position)/movement_time;  
            
            for (pos = 0; pos < movement_time; pos += 1) { 
                x_position = x_position + x_speed;
                y_position = y_position + y_speed;
                x_servo.write(x_position);  
                y_servo.write(y_position);                    
                delay(10); 
            }
            
            // Store old position
            x_old_position = x_new_position;
            y_old_position = y_new_position;
            delay(random_delay);
        }
    }
    // Turn off laser and servos
    digitalWrite (13, LOW); // switch off laser
    y_servo.detach();  // detaches the y servo on pin 6 to the servo object
    x_servo.detach();  // detaches the x servo on pin 9 to the servo object
    
    // Wait to repeat
    delay(delay_ms);
}
